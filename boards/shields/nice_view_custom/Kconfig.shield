## boards/shields/nice_view_custom/Kconfig.shield
```kconfig
# Copyright (c) 2022 The ZMK Contributors
# SPDX-License-Identifier: MIT

config SHIELD_NICE_VIEW_CUSTOM   # line 4
    def_bool $(shields_list_contains,nice_view_custom)   # line 5
```

## west.yml
```yaml
manifest:
  remotes:
    - name: remote-name
      url-base: https://github.com/Topher083/zmk-nice-view-custom
  projects:
    # Together with the above defined remote, this refers to a module located at
    # https://github.com/remote-name/repository-name
    - name: zmk-nice-view-custom
      remote: remote-name
      # This points to a west manifest file in the remote module for further imports
      import: west.yml
```
